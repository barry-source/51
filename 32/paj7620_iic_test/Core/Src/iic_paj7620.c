#include "iic_paj7620.h"
#include "stdio.h"
#include "iic.h"

#define INIT_REG_ARRAY_SIZE (sizeof(initRegisterArray)/sizeof(initRegisterArray[0]))
	
uint8_t initRegisterArray[][2] = {	// Initial Gesture
  {0xEF,0x00},
	{0x32,0x29},
	{0x33,0x01},
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	{0x7E,0x01},
};

void paj7620_init(void) {
	paj_iic_init();
	paj_it_init();
	paj_init();
}

void paj_iic_init() {	
	GPIO_InitTypeDef GPIO_InitStruct = {0};

	__HAL_RCC_GPIOB_CLK_ENABLE();
	GPIO_InitStruct.Pin = IIC_SCL_PIN;
	GPIO_InitStruct.Mode = GPIO_MODE_OUTPUT_OD;
	GPIO_InitStruct.Speed = GPIO_SPEED_FREQ_HIGH;
	HAL_GPIO_Init(IIC_GPIO_PORT, &GPIO_InitStruct);
	GPIO_InitStruct.Pin = IIC_SDA_PIN;
	HAL_GPIO_Init(IIC_GPIO_PORT, &GPIO_InitStruct);
	
	// 拉高SCL SDA 使总线空闲
	HAL_GPIO_WritePin(IIC_GPIO_PORT, IIC_SCL_PIN, GPIO_PIN_SET);
	HAL_GPIO_WritePin(IIC_GPIO_PORT, IIC_SDA_PIN, GPIO_PIN_SET);
}

void paj_it_init(void) {
	__HAL_RCC_GPIOB_CLK_ENABLE();
	GPIO_InitTypeDef gpioInit;
	gpioInit.Pin = PAJ7620_IT_PIN;
	gpioInit.Mode = GPIO_MODE_INPUT;
	HAL_GPIO_Init(PAJ7620_IT_PORT, &gpioInit);
}

uint8_t paj7620_getInterrupt(void) {
	return HAL_GPIO_ReadPin(PAJ7620_IT_PORT, PAJ7620_IT_PIN) == 0;
}

uint8_t paj_init(void) {
	uint8_t data = 0, rtn = 0;
	uint16_t cnt = 0;
	
	delay_us(700);	//Wait 700us for PAJ7620U2 to stabilize
	paj7620_sekect_bank(PAJ7620_BANK0);
	// 读0x00地址，正常会返回0x20
	rtn = iic_read_7620(PAJ7620_ADDRESS, PAJ7620_ADDR_PART_ID_0, &data, 1);
	if(rtn) {
		return rtn;
	}
	if(data != PAJ7620_PART_ID_0)
	{
		return 0xff;
	}
	// 这一步文档上没有找到说明
	rtn = iic_read_7620(PAJ7620_ADDRESS, PAJ7620_ADDR_PART_ID_1, &data, 1);
	if(rtn)
	{
		return rtn;
	}
	if(data != PAJ7620_PART_ID_1)
	{
		return 0xfe;
	}
	for (cnt = 0; cnt < INIT_REG_ARRAY_SIZE; cnt++) 
	{
		rtn = iic_write_7620(PAJ7620_ADDRESS, initRegisterArray[cnt][0], &initRegisterArray[cnt][1], 1);
		if(rtn)
		{
			return rtn;
		}
	}
	
	paj7620_sekect_bank(PAJ7620_BANK1);  //gesture flage reg in Bank1
	// 这一步文档上没有找到说明
	//data = 0xB7;	// far mode 120 fps
	//data = 0x12;  		// near mode 240 fps
	//iic_write_7620(PAJ7620_ADDRESS, 0x65, &data, 1); 

	paj7620_sekect_bank(PAJ7620_BANK0);  //gesture flage reg in Bank0
	
	return 0;
}

uint8_t paj7620_sekect_bank(uint8_t bank) {
	uint8_t rtn = 0;
	if(bank == PAJ7620_BANK0 || bank == PAJ7620_BANK1)
	{
		rtn = iic_write_7620(PAJ7620_ADDRESS, PAJ7620_REGITER_BANK_SEL, &bank, 1);
	}
	else
	{
		rtn = 0xff;
	}
	return rtn;
}

uint16_t paj7620_get_gesture(void) {
	uint8_t rRtn = 0, rData[2] = {0};
	uint16_t gCode = 0;
	rRtn  = iic_read_7620(PAJ7620_ADDRESS, PAJ7620_ADDR_GES_PS_DET_FLAG_0, rData, 2);
	if(rRtn)
	{
		return rRtn;
	}
	gCode = (rData[1]<<8) & 0xff00 | rData[0];
	return gCode;
}

void paj7620_action(void) {
	uint16_t gCode = 0;
	gCode = paj7620_get_gesture();
	printf("%d====》", gCode);
	 switch (gCode) {
		case 0x01: // up
			paj7620_up();
			break;
		case 0x02: // down
			paj7620_down();
			break;
		case 0x04: // left
			paj7620_left();
			break;
		case 0x08: // right
			paj7620_right();
			break;
		case 0x10: // push
			paj7620_push();
			break;
		case 0x20: // pop
			paj7620_pop();
			break;
		case 0x40: // rotate right
			paj7620_rotate_right();
			break;
		case 0x80: // rotate left
			paj7620_rotate_left();
			break;
		case 0x100:// wave
			paj7620_wave();
			break;
		case 0x00: // nothing
			paj7620_nothing();
		 	break;
		default:
			paj7620_error();
	}
}

void paj7620_up(void) {
	printf("up\r\n");
}

void paj7620_down(void) {
	printf("down\r\n");
}
void paj7620_left(void) {
	printf("left\r\n");
}

void paj7620_right(void) {
	printf("right\r\n");
}

void paj7620_push(void) {
	printf("push\r\n");
}

void paj7620_pop(void)
{
	printf("pop\r\n");
}

void paj7620_rotate_right(void) {
	printf("rotate right\r\n");
}

void paj7620_rotate_left(void) {
	printf("rotate left\r\n");
}

void paj7620_wave(void) {
	printf("wave\r\n");
}

void paj7620_nothing(void) {
	printf("nothing\r\n");
}

void paj7620_error(void) {
	printf("error\r\n");
}




