#include "oled.h"
#include "oledFont.h"
#include "i2c.h"

unsigned char peiqi[]=
{
0x00,0x00,0x00,0x00,0x00,0x00,0x00,0x00,0xC0,0x30,0x90,0x50,0x50,0x90,0x20,0x7E,
0xC1,0x1D,0x64,0x44,0x79,0x02,0xBC,0x90,0xD0,0x50,0x90,0x88,0x28,0x68,0xA8,0x28,
0xA8,0x04,0xE4,0x54,0x54,0x64,0x68,0x48,0x90,0x20,0xC0,0x00,0x00,0x00,0x00,0x00,
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0x00,0x00,0x00,0x00,0x00,0x00,0x00,0x00,0x00,0x00,0x00,0x00,0x00,0x00,0x00,0x00,
};

void iic_write_cmd(uint8_t cmd) {
	HAL_I2C_Mem_Write(&hi2c1, 0x78, 0x00, I2C_MEMADD_SIZE_8BIT,
										&cmd, 1, 0xff);
}

void iic_write_data(uint8_t data) {
	HAL_I2C_Mem_Write(&hi2c1, 0x78, 0x40, I2C_MEMADD_SIZE_8BIT,
										&data, 1, 0xff);
}

void oled_init() {
	iic_write_cmd(0xAE);//--display off
	iic_write_cmd(0x00);//---set low column address
	iic_write_cmd(0x10);//---set high column address
	iic_write_cmd(0x40);//--set start line address  
	iic_write_cmd(0xB0);//--set page address
	iic_write_cmd(0x81); // contract control
	iic_write_cmd(0xFF);//--128   
	iic_write_cmd(0xA1);//set segment remap 
	iic_write_cmd(0xA6);//--normal / reverse
	iic_write_cmd(0xA8);//--set multiplex ratio(1 to 64)
	iic_write_cmd(0x3F);//--1/32 duty
	iic_write_cmd(0xC8);//Com scan direction
	iic_write_cmd(0xD3);//-set display offset
	iic_write_cmd(0x00);//
	
	iic_write_cmd(0xD5);//set osc division
	iic_write_cmd(0x80);//
	
	iic_write_cmd(0xD8);//set area color mode off
	iic_write_cmd(0x05);//
	
	iic_write_cmd(0xD9);//Set Pre-Charge Period
	iic_write_cmd(0xF1);//
	
	iic_write_cmd(0xDA);//set com pin configuartion
	iic_write_cmd(0x12);//
	
	iic_write_cmd(0xDB);//set Vcomh
	iic_write_cmd(0x30);//
	
	iic_write_cmd(0x8D);//set charge pump enable
	iic_write_cmd(0x14);//
	
	iic_write_cmd(0xAF);//--turn on oled panel		
}

void oled_clear(uint8_t x0, uint8_t x1, uint8_t y0, uint8_t y1) {
	assert_param(x0 <= 8);
	assert_param(x1 <= 8);
	assert_param(x1 >= x0);
	
	assert_param(y0 <= 128);
	assert_param(y1 <= 128);
	assert_param(y1 >= y0);
	
	int i, j;
	//选择页模式
	iic_write_cmd(0x20);
	iic_write_cmd(0x02);
	for(i = x0; i < x1; i ++) {
		iic_write_cmd(0xB0+i);
		iic_write_cmd(0x00 + y0 % 16);
		iic_write_cmd(0x10 + y0 / 16);
		for(j = y0; j < y1; j ++) { 
				iic_write_data(0);
		}
	}
}

void oled_clear_1_line() {
	oled_clear(0, 2, 0, 128);
}

void oled_clear_2_line() {
	oled_clear(2, 4, 0, 128);
}

void oled_clear_3_line() {
	oled_clear(4, 6, 0, 128);
}

void oled_clear_4_line() {
	oled_clear(6, 8, 0, 128);
}

void oled_clear_all() {
	oled_clear(0, 8, 0, 128);
}

void old__clear_top_half() {
	oled_clear(1, 4, 0, 128);
}

void old__clear_bottom_half() {
	oled_clear(4, 8, 0, 128);
}

void oled_image(unsigned char *image)
{
	unsigned char i; 
	unsigned int j;
	
	for(i=0;i<8;i++){
		iic_write_cmd(0xB0 + i);
		iic_write_cmd(0x00);
		iic_write_cmd(0x10);
	
		for(j = 128 * i; j<(128 * (i+1));j++){
			iic_write_data(image[j]);
		}
	}
}


void Oled_Show_Char(char row,char col,char oledChar) { //row*2-2
	unsigned int  i;
	iic_write_cmd(0xb0+(row*2-2));                           //page 0
	iic_write_cmd(0x00+(col&0x0f));                          //low
	iic_write_cmd(0x10+(col>>4));                            //high	
	for(i=((oledChar-32)*16);i<((oledChar-32)*16+8);i++){
		iic_write_data(F8X16[i]);                            //写数据oledTable1
	}

	iic_write_cmd(0xb0+(row*2-1));                           //page 1
	iic_write_cmd(0x00+(col&0x0f));                          //low
	iic_write_cmd(0x10+(col>>4));                            //high
	for(i=((oledChar-32)*16+8);i<((oledChar-32)*16+8+8);i++){
		iic_write_data(F8X16[i]);                            //写数据oledTable1
	}		
}


/******************************************************************************/
// 函数名称：Oled_Show_Char 
// 输入参数：oledChar 
// 输出参数：无 
// 函数功能：OLED显示单个字符
/******************************************************************************/
void oled_show_string(char row,char col,char *str) {
	while(*str!=0){
		Oled_Show_Char(row,col,*str);
		str++;
		col += 8;	
	}		
}

/////////////////////////////////////////////////////////////////////
