#include "reg52.h"
#include "intrins.h"
#include "oled.h"
#include "Oledfont.h"

sbit SDA = P1^3;
sbit SCL = P1^2;

code unsigned char peiqi[]=
{
0x00,0x00,0x00,0x00,0x00,0x00,0x00,0x00,0xC0,0x30,0x90,0x50,0x50,0x90,0x20,0x7E,
0xC1,0x1D,0x64,0x44,0x79,0x02,0xBC,0x90,0xD0,0x50,0x90,0x88,0x28,0x68,0xA8,0x28,
0xA8,0x04,0xE4,0x54,0x54,0x64,0x68,0x48,0x90,0x20,0xC0,0x00,0x00,0x00,0x00,0x00,
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0x00,0x00,0x00,0x00,0x00,0x00,0x00,0x00,0x00,0x00,0x00,0x00,0x00,0x00,0x00,0x00,
};


void iic_start() {
	SCL = 1;
	SDA = 1;
	_nop_();
	SDA = 0;
	_nop_();
}

void iic_stop() {
	SCL = 1;
	SDA = 0;
	_nop_();
	SDA = 1;
	_nop_();
}

char iic_ack() {
	char result;
	SDA = 1;//就在时钟脉冲9期间释放数据线
	_nop_();
	SCL = 1;
	result = SDA;
	_nop_();
	SCL = 0;
	_nop_();
	return result;
}

void iic_sendByte(char byte) {
	char temp = byte;
	int i;
	for(i = 0; i < 8; i ++) {
		SCL = 0;
		SDA = temp & 0x80;
		_nop_();
		SCL = 1;
		_nop_();
		// 拉低电平
		SCL = 0;
		_nop_();
		temp <<= 1;
	}
}

void iic_write_cmd(char cmd) {
	iic_start();
	// 01111100 + R/W(0是写操作)
	iic_sendByte(0x78);
	iic_ack();
	// C0 + D/C + XXXXXX  ==> D/C = 1 表示数据  = 0 表示命令  
	iic_sendByte(0x00);
	iic_ack();
	iic_sendByte(cmd);
	iic_ack();
	iic_stop();
}

void iic_write_data(char d) {
	iic_start();
	// 01111100 + R/W(0是写操作)
	iic_sendByte(0x78);
	iic_ack();
	// C0 + D/C + XXXXXX  ==> D/C = 1 表示数据  = 0 表示命令  
	iic_sendByte(0x40);
	iic_ack();
	iic_sendByte(d);
	iic_ack();
	iic_stop();
}


void oled_init() {
	iic_write_cmd(0xAE);//--display off
	iic_write_cmd(0x00);//---set low column address
	iic_write_cmd(0x10);//---set high column address
	iic_write_cmd(0x40);//--set start line address  
	iic_write_cmd(0xB0);//--set page address
	iic_write_cmd(0x81); // contract control
	iic_write_cmd(0xFF);//--128   
	iic_write_cmd(0xA1);//set segment remap 
	iic_write_cmd(0xA6);//--normal / reverse
	iic_write_cmd(0xA8);//--set multiplex ratio(1 to 64)
	iic_write_cmd(0x3F);//--1/32 duty
	iic_write_cmd(0xC8);//Com scan direction
	iic_write_cmd(0xD3);//-set display offset
	iic_write_cmd(0x00);//
	
	iic_write_cmd(0xD5);//set osc division
	iic_write_cmd(0x80);//
	
	iic_write_cmd(0xD8);//set area color mode off
	iic_write_cmd(0x05);//
	
	iic_write_cmd(0xD9);//Set Pre-Charge Period
	iic_write_cmd(0xF1);//
	
	iic_write_cmd(0xDA);//set com pin configuartion
	iic_write_cmd(0x12);//
	
	iic_write_cmd(0xDB);//set Vcomh
	iic_write_cmd(0x30);//
	
	iic_write_cmd(0x8D);//set charge pump enable
	iic_write_cmd(0x14);//
	
	iic_write_cmd(0xAF);//--turn on oled panel		
}


void oled_clear() {
	int i, j;
	for(i = 0; i < 8; i ++) {
		iic_write_cmd(0xB0+i);
		iic_write_cmd(0x00);
		iic_write_cmd(0x10);
		for(j = 0; j < 128; j ++) {
			iic_write_data(0);
		}
	}
}


void oled_image(unsigned char *image)
{
	unsigned char i; 
	unsigned int j;
	
	for(i=0;i<8;i++){
		iic_write_cmd(0xB0 + i);
		iic_write_cmd(0x00);
		iic_write_cmd(0x10);
	
		for(j = 128 * i; j<(128 * (i+1));j++){
			iic_write_data(image[j]);
		}
	}
}


void Oled_Show_Char(char row,char col,char oledChar){ //row*2-2
	unsigned int  i;
	iic_write_cmd(0xb0+(row*2-2));                           //page 0
	iic_write_cmd(0x00+(col&0x0f));                          //low
	iic_write_cmd(0x10+(col>>4));                            //high	
	for(i=((oledChar-32)*16);i<((oledChar-32)*16+8);i++){
		iic_write_data(F8X16[i]);                            //写数据oledTable1
	}

	iic_write_cmd(0xb0+(row*2-1));                           //page 1
	iic_write_cmd(0x00+(col&0x0f));                          //low
	iic_write_cmd(0x10+(col>>4));                            //high
	for(i=((oledChar-32)*16+8);i<((oledChar-32)*16+8+8);i++){
		iic_write_data(F8X16[i]);                            //写数据oledTable1
	}		
}


/******************************************************************************/
// 函数名称：Oled_Show_Char 
// 输入参数：oledChar 
// 输出参数：无 
// 函数功能：OLED显示单个字符
/******************************************************************************/
void Oled_Show_Str(char row,char col,char *str){
	while(*str!=0){
		Oled_Show_Char(row,col,*str);
		str++;
		col += 8;	
	}		
}

void test() {
	oled_init();
	iic_write_cmd(0x20);
	iic_write_cmd(0x02);
	
	oled_clear();
	
	oled_image(peiqi);
	
}

